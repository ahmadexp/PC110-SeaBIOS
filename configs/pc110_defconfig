## configs/pc110_defconfig
```kconfig
CONFIG_PC110=y
CONFIG_PC110_CHIPSET_POST=y
# CONFIG_QEMU is not set
# CONFIG_COREBOOT is not set
# CONFIG_CSM is not set
# CONFIG_QEMU_HARDWARE is not set
# CONFIG_XEN is not set
# CONFIG_THREADS is not set
CONFIG_RELOCATE_INIT=y
CONFIG_BOOTMENU=y
# CONFIG_BOOTSPLASH is not set
# CONFIG_BOOTORDER is not set
# CONFIG_HOST_BIOS_GEOMETRY is not set
# CONFIG_COREBOOT_FLASH is not set
# CONFIG_MULTIBOOT is not set
CONFIG_ENTRY_EXTRASTACK=y
CONFIG_MALLOC_UPPERMEMORY=y
CONFIG_ROM_SIZE=256
CONFIG_ATA=y
# CONFIG_ATA_DMA is not set
# CONFIG_ATA_PIO32 is not set
# CONFIG_AHCI is not set
# CONFIG_SDCARD is not set
# CONFIG_VIRTIO_BLK is not set
# CONFIG_VIRTIO_SCSI is not set
# CONFIG_PVSCSI is not set
# CONFIG_ESP_SCSI is not set
# CONFIG_LSI_SCSI is not set
# CONFIG_MEGASAS is not set
# CONFIG_MPT_SCSI is not set
CONFIG_FLOPPY=y
# CONFIG_FLASH_FLOPPY is not set
# CONFIG_NVME is not set
CONFIG_PS2PORT=y
# CONFIG_USB is not set
CONFIG_SERIAL=y
# CONFIG_SERCON is not set
CONFIG_LPT=y
CONFIG_RTC_TIMER=y
CONFIG_HARDWARE_IRQ=y
# CONFIG_USE_SMM is not set
# CONFIG_MTRR_INIT is not set
# CONFIG_PMTIMER is not set
# CONFIG_TSC_TIMER is not set
CONFIG_DRIVES=y
# CONFIG_CDROM_BOOT is not set
# CONFIG_PCIBIOS is not set
CONFIG_APMBIOS=y
CONFIG_PNPBIOS=y
CONFIG_OPTIONROMS=y
CONFIG_PMM=y
CONFIG_BOOT=y
CONFIG_KEYBOARD=y
CONFIG_KBD_CALL_INT15_4F=y
CONFIG_MOUSE=y
# CONFIG_S3_RESUME is not set
# CONFIG_VGAHOOKS is not set
# CONFIG_DISABLE_A20 is not set
# CONFIG_TCGBIOS is not set
# CONFIG_BUILD_VGABIOS is not set
CONFIG_DEBUG_LEVEL=1
# CONFIG_DEBUG_SERIAL is not set
# CONFIG_DEBUG_SERIAL_MMIO is not set
```
